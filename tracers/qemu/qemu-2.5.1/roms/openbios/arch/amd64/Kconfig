## tracers/qemu/qemu-2.5.1/roms/openbios/arch/amd64/Kconfig
```kconfig
mainmenu "OpenBIOS Configuration"

config AMD64
	bool
	default y
	help
	  Building for AMD64 hardware.

config LITTLE_ENDIAN
	bool
	default y
	help
	  AMD64 is little endian.


menu "Kernel binaries (AMD64)"

config IMAGE_ELF
	bool "ELF image (for LinuxBIOS)"
	default y
	help
	  Build a simple elf image that can be used with LinuxBIOS
	  This image will be called openbios.elf

config IMAGE_ELF_EMBEDDED
	bool "ELF image with embedded dictionary"
	default y
	help
	  Build an elf image with embedded dictionary. This image
	  can easily be used with etherboot. 
	  The image filename is openbios.full

config IMAGE_ELF_MULTIBOOT
	bool "Multiboot image"
	default y
	help
	  Build a multiboot image for booting with grub

endmenu

menu "Build hosted UNIX Binary"
source "arch/unix/Kconfig"
endmenu

source "kernel/Kconfig"
source "forth/Kconfig"
source "libopenbios/Kconfig"
source "drivers/Kconfig"
```

## tracers/qemu/qemu-2.5.1/roms/openbios/arch/ia64/Kconfig
```kconfig
mainmenu "OpenBIOS Configuration"

config IPF
	bool
	default y
	help
	  Building for IPF hardware.

config LITTLE_ENDIAN
	bool
	default y
	help
	  IPF is little endian.

menu "Build hosted UNIX Binary"
source "arch/unix/Kconfig"
endmenu

source "kernel/Kconfig"
source "forth/Kconfig"
source "libopenbios/Kconfig"
source "drivers/Kconfig"
```

## tracers/qemu/qemu-2.5.1/roms/openbios/arch/ppc/Kconfig
```kconfig
mainmenu "OpenBIOS Configuration"

config PPC
	bool
	default y
	help
	  Building for PPC hardware.

config BIG_ENDIAN
	bool
	default y
	help
	  PPC hardware is big endian (per default)

choice
	prompt "Platform Type"
	default MOL

config MOL
	bool "Mac-on-Linux"
	help
	  Build an image for Mac-on-Linux

config MPC107
	bool "MPC107 board (Crescendo)"
	help
	  Build for Crescendo board.

config BRIQ
	bool "Total Impact briQ"
	help
	  Build an image for the Total Impact briQ

config NO_ARCH
	bool "None"
	help
	  Don't build any images.

endchoice

menu "Build hosted UNIX Binary"
source "arch/unix/Kconfig"
endmenu

source "kernel/Kconfig"
source "forth/Kconfig"
source "libopenbios/Kconfig"
source "drivers/Kconfig"
```

## tracers/qemu/qemu-2.5.1/roms/openbios/arch/unix/Kconfig
```kconfig
config HOST_UNIX
	bool "Build Hosted Unix binary"
	default y
	help
	  Build a version of the OpenBIOS kernel that runs in a 
	  Unix-like operating system.

config UNIX_QT
	depends HOST_UNIX
	bool "QT frontend for Unix binary"
	default n
	help
	  Enable this option if you wish to add a graphical user 
	  interface to the openbios hosted unix binary. This option
	  needs the QT library installed.

source "arch/unix/plugins/Kconfig"
```

## tracers/qemu/qemu-2.5.1/roms/openbios/arch/unix/plugins/Kconfig
```kconfig
config PLUGINS
	depends HOST_UNIX
	bool "Plugin system (obsolete)"
	default n
	
config PLUGIN_PCI
	depends HOST_UNIX && PLUGINS
	bool "PCI Emulation"
	default n

config PLUGIN_QT
	bool "QT Display Emulation"
	depends HOST_UNIX && PLUGINS && PLUGIN_PCI
	default n
	help
	  This plugin needs qt installed. Disable if you don't have qt.
```

## tracers/qemu/qemu-2.5.1/roms/openbios/arch/x86/Kconfig
```kconfig
mainmenu "OpenBIOS Configuration"

config X86
	bool
	default y
	help
	  Building for X86 hardware.

config LITTLE_ENDIAN
	bool
	default y
	help
	  X86 is little endian

menu "Kernel binaries (x86)"

config IMAGE_ELF
	bool "ELF image (for LinuxBIOS)"
	default y
	help
	  Build a simple elf image that can be used with LinuxBIOS
	  This image will be called openbios.elf

config IMAGE_ELF_EMBEDDED
	bool "ELF image with embedded dictionary"
	default y
	help
	  Build an elf image with embedded dictionary. This image
	  can easily be used with etherboot. 
	  The image filename is openbios.full

config IMAGE_ELF_MULTIBOOT
	bool "Multiboot image"
	default y
	help
	  Build a multiboot image for booting with grub

endmenu

menu "Build hosted UNIX Binary"
source "arch/unix/Kconfig"
endmenu

source "kernel/Kconfig"
source "forth/Kconfig"
source "libopenbios/Kconfig"
source "drivers/Kconfig"
```

## tracers/qemu/qemu-2.5.1/roms/openbios/drivers/Kconfig
```kconfig
menu "Drivers"

config DRIVER_PCI
	bool "PCI driver"
	default y
	help
	  Builtin PCI driver

config DEBUG_PCI
	bool "Debug PCI driver"
	default n
	help
	  Debug PCI driver
	  
config DRIVER_IDE
	depends X86 || AMD64 || PPC
	bool "Legacy IDE"
	default y
	help
	  If you want to be able to boot from IDE, enable this option.

config IDE_NUM_CHANNELS
	depends DRIVER_IDE
	int "Number of IDE channels to be probed"
	default 4
	help
	  Number of IDE channels to be probed. This should be set to
	  one or two if you build OpenBIOS for the Total Impact BRIQ.

config DEBUG_IDE
	depends DRIVER_IDE
        bool "Debug IDE driver"
	default n
	help
	  Debug IDE driver 
	
config DRIVER_USB
	bool "USB Support"
	default n
	help
	  If you want to be able to use USB devices, enable this option.

config DEBUG_USB
	depends DRIVER_USB
	bool "Debug USB driver"
	default n
	help
	  Debug USB driver

config USB_HID
	depends DRIVER_USB
	bool "USB driver for HID devices"
	default n
	help
	  If you want to be able to use USB keyboard, enable this option.

endmenu
```

## tracers/qemu/qemu-2.5.1/roms/openbios/forth/packages/Kconfig
```kconfig
config PKG_DEBLOCKER
	bool "Deblocker"
	default y

config PKG_DISKLABEL
	bool "Disk Label"
	default y

config PKG_OBP_TFTP
	bool "OBP-TFTP"
	default y

config PKG_TERMINAL_EMULATOR
	bool "Terminal Emulator"
	default y
```

## tracers/qemu/qemu-2.5.1/roms/openbios/fs/grubfs/Kconfig
```kconfig
config FSYS_EXT2FS
	depends on GRUBFS
	bool "EXT2 support"
	default n
	help
	  Include EXT2 filesystem support

config FSYS_FAT
	depends on GRUBFS
	bool "(V)FAT support"
	default n
	help
	  Include VFAT/FAT (MSDOS / Windows95) filesystem support

config FSYS_JFS
	depends on GRUBFS
	bool "JFS support"
	default n
	help
	  Include JFS support

config FSYS_MINIX
	depends on GRUBFS
	bool "Minix filesystem support"
	default n
	help
	  Include Minix filesystem support

config FSYS_REISERFS
	depends on GRUBFS
	bool "Reiser filesystem support"
	default n
	help
	  Include Reiser filesystem support
	  
config FSYS_XFS
	depends on GRUBFS
	bool "XFS support"
	default n
	help
	  Include XFS support

config FSYS_UFS
	depends on GRUBFS
	bool "UFS/UFS2 support"
	default n
	help
	  Include UFS/UFS2 support

config FSYS_ISO9660
	depends on GRUBFS
	bool "ISO 9660 support"
	default n
	help
	  Include ISO9660 (cdrom) filesystem support

config FSYS_FFS
	depends on GRUBFS
	bool "FreeBSD FFS support"
	default n
	help
	  Include FreeBSD FFS filesystem support

config FSYS_VSTAFS
	depends on GRUBFS
	bool "VSTA filesystem support"
	default n
	help
	  Include VSTA filesystem support

config FSYS_NTFS
	depends on GRUBFS
	bool "NT filesystem support"
	default n
	help
	  Include NTFS filesystem support

config FSYS_AFFS
	depends on GRUBFS
	bool "Amiga fast filesystem support"
	default n
	help
	  Include Amiga FFS filesystem support
```

## tracers/qemu/qemu-2.5.1/roms/openbios/kernel/Kconfig
```kconfig
menu "Kernel Debugging"

config DEBUG
	bool "Kernel Debugging"
	default y
	help
	  Kernel Debugging

config DEBUG_BOOT
	bool "Boot messages"
	depends on DEBUG
	default y
	help
	  early boot code (multiboot parsing etc)

config DEBUG_DSTACK
	bool "dstack messages"
	depends on DEBUG
	default n
	help
	  stack debugging. warning: heavy output!

config DEBUG_RSTACK
	bool "rstack messages"
	depends on DEBUG
	default n
	help
	  stack debugging. warning: heavy output!

config DEBUG_DICTIONARY
	bool "Dictionary loading/dumping"
	depends on DEBUG
	default n
	help
	  print few additional information on dictionary loading/dumping

config DEBUG_INTERNAL
	bool "Prime Words"
	depends on DEBUG
	default n
	help
	  print additional information for some prime words, like branches

config DEBUG_INTERPRETER
	bool "Interpreter"
	depends on DEBUG
	default n
	help
	  additional information about the unix.c builtin C interpreter
	  and some other places where it actually does not belong.
	
config DEBUG_CONSOLE
	bool "Console"
	default y
	help
	  use builtin C console code for user interaction. There is no
	  real alternative to this until someone writes a display/kbd or
	  serial driver in forth.

config DEBUG_CONSOLE_SERIAL
	bool "Serial Console"
	depends on DEBUG_CONSOLE
	default y
	help
	  use serial console.

config SERIAL_PORT
	int "Serial Port"
	depends on DEBUG_CONSOLE_SERIAL
	default "1"
	help
	  0 for none, 1 for ttyS0, 2 for ttyS1

config SERIAL_SPEED
	int "Serial line speed"
	depends on DEBUG_CONSOLE_SERIAL
	default "115200"
	help
	  supported speeds are: 115200, 57600, 38400, 19200, 9600
	  
config DEBUG_CONSOLE_VGA
	bool "VGA Console"
	depends on DEBUG_CONSOLE
	default y
	help
	  use vga textmode and keyboard console

endmenu
```

## tracers/qemu/qemu-2.5.1/roms/openbios/libopenbios/Kconfig
```kconfig
menu "Module Configuration"


config CMDLINE
	bool "Command Line Editing"
	default y
	help
	  Improved openfirmware prompt

config DEBLOCKER
	bool "Deblocker"
	default y
	help
	  Deblocker implementation

endmenu

menu "Filesystem Configuration"

config DISK_LABEL
	bool "Disk-Label"
	default y
	help
	  Disk-label package implementation

config PART_SUPPORT
	depends on DISK_LABEL
	bool "Partition support"
	default y
	help
	  Support for partition tables

config MAC_PARTS
	depends on PART_SUPPORT && BIG_ENDIAN
	bool "Mac partition support"
	default y
	help
	  Support for Macintosh partition tables

config PC_PARTS
	depends on PART_SUPPORT
	bool "PC style partition support"
	default y
	help
	  Support for PC style partition tables

config FS
	depends on DISK_LABEL
	bool "Filesystem Support"
	default y
	help
	  Include filesystem support

config HFS
	depends on FS && BIG_ENDIAN
	bool "HFS support"
	default y
	help
	  Include HFS support

config HFSP
	depends on FS && BIG_ENDIAN
	bool "HFS+ support"
	default y
	help
	  Include HFS+ support

config GRUBFS
	depends on FS
	bool "Additional Filesystems (from GRUB)"
	default y
	help
	  Grub provides a lot of filesystem drivers. 

source "fs/grubfs/Kconfig"

config DEBUG_FS
	depends on FS
	bool "Debugging output for Filesystem code"
	default y
	help
	  Say Y here if you want to debug the filesystem layer

endmenu
	  
menu "Miscellaneous"

config LINUXBIOS
	bool "Support reading LinuxBIOS table"
	default y
	help
	  If you want to boot OpenBIOS as a LinuxBIOS payload,
	  you should say Y here.

endmenu
```
